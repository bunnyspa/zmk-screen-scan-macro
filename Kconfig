## Kconfig
```kconfig
config ZMK_SCREEN_SCAN_MACRO
    bool "Screen Scan Macro - host-driven HID relay"
    depends on RAW_HID
    default n
    help
      Receives action commands from the host screen-scan-macro engine over
      Raw HID (marker 0x4D) and emits them as real keyboard/mouse HID
      reports. Also provides the &ssm_tog behavior, which broadcasts a
      start/stop toggle to the host over the same transport (marker 0x4E).

      Requires a zmk,behavior-ssm-tog devicetree node (see docs/wire-protocol.md).
      Pair with the zmk-screen-scan-macro host application running on the
      connected PC. Central half only, same as other Raw HID consumers.

if ZMK_SCREEN_SCAN_MACRO

config ZMK_SCREEN_SCAN_MACRO_CMD_MARKER
    hex "Raw HID marker byte, host -> keyboard action-command channel"
    default 0x4D
    help
      Change only to resolve a collision with another Raw HID listener
      sharing this transport (see docs/modules/README.md's marker-byte
      registry in zmk-config). The host side (protocol.py's marker
      constant) must be updated to match by hand - it is not derived from
      this Kconfig automatically.

config ZMK_SCREEN_SCAN_MACRO_TRIGGER_MARKER
    hex "Raw HID marker byte, keyboard -> host trigger channel"
    default 0x4E
    help
      Change only to resolve a collision with another Raw HID listener
      sharing this transport. The host side (hid_link.py's marker
      constant) must be updated to match by hand - it is not derived from
      this Kconfig automatically.

endif # ZMK_SCREEN_SCAN_MACRO
```

## dts/bindings/behaviors/zmk,behavior-ssm-confirm.yaml
```yaml
# Screen Scan Macro - confirmation-mode confirm key behavior

description: Confirms a pending action (click or key-press) while the screen-scan-macro host engine is paused in confirmation mode

compatible: "zmk,behavior-ssm-confirm"

include: zero_param.yaml
```

## dts/bindings/behaviors/zmk,behavior-ssm-tog.yaml
```yaml
# Screen Scan Macro - start/stop toggle behavior

description: Toggles the screen-scan-macro host engine's run state over Raw HID

compatible: "zmk,behavior-ssm-tog"

include: zero_param.yaml
```

## spike/firmware/Kconfig
```kconfig
config ZMK_SCREEN_SCAN_MACRO_SPIKE
    bool "Screen Scan Macro - real HID emission spike"
    depends on RAW_HID
    default n
    help
      Minimal proof-of-concept, not the real module: any Raw HID packet
      whose first byte is the spike marker (0xA0) triggers a hardcoded
      'A' key tap emitted as a real HID keyboard report.

      Exists only to hardware-confirm zmk_hid_keyboard_press()/
      zmk_endpoint_send_report() are safely callable from a raw-HID
      listener callback, before the full screen-scan-macro module is
      built. Central half only, same as other Raw HID consumers.
```
